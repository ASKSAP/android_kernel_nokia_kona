## drivers/fps/cdfinger/Kconfig
```kconfig
#
# cdfinger fingerprint driver configuration
#

config FPS_CDFINGER
    tristate "cdfinger fingerprint driver support"
    help
    select cdfinger_fp
      This support cdfinger fingerprint drivers.
```

## drivers/fps/focaltech/Kconfig
```kconfig
#
# cdfinger fingerprint driver configuration
#
	  
config FPS_FOCALTECH
	tristate "focaltech fingerprint driver support"
	select focaltech_fp
	help
	  This support focaltech fingerprint drivers.
```

## drivers/fps/silead/Kconfig
```kconfig
#
# Silead Fingerprint driver configuration
#
	  
config FPS_SILEAD
	tristate "Silead platformm Fingerprint driver support"
	select silead_fp
	help
	  This supports Silead platform Fingerprint drivers.
```

## drivers/input/touchscreen/ILI_touch/Kconfig
```kconfig
#
# ILI_7807G Touchscreen driver configuration
#

config TOUCHSCREEN_ILI_7807G
    bool "ILI_7807G Touchscreen"
    default n
    help
      Say Y here if you have Focaltech touch panel.
      If unsure, say N.
```

## drivers/input/touchscreen/ILI_touch_v3/Kconfig
```kconfig
#
# ILI_7806S Touchscreen driver configuration
#

config TOUCHSCREEN_ILI_7806S
    bool "ILI_7806S Touchscreen"
    default n
    help
      Say Y here if you have Focaltech touch panel.
      If unsure, say N.
```

## drivers/misc/huaqin/Kconfig
```kconfig
#
# for huaqin mis info
#

# huaqin added by SunXunou for HMD_ZQL1838 at 20200518 start
config HQ_SIM_TRAY_CHECK
	bool "check sim stry status"
        default y
	help
	  this will create a node to show sim tray status.

	  If unsure, say N.
# huaqin added by SunXunou for HMD_ZQL1838 at 20200518 end
# huaqin added by zhouzichun for HMD_ZQL1838 at 20200518 start
config HW_INFO
	bool "show hw info"
        default n
	help
	  this will create a node to show some hw info.

	  If unsure, say N.
# huaqin added by zhouzichun for HMD_ZQL1838 at 20200518 end

# huaqin added for DRSTRANGE-346 by yutao at 2020/06/19 start
config RECORD_CRASH_INFO
    bool "Record crash info"
    default n
    help
      record crash info
# huaqin added for DRSTRANGE-346 by yutao at 2020/06/19 end
```
